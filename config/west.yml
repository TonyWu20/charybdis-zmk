## config/west.yml
```yaml
manifest:
  remotes:
    - name: TonyWu20
      url-base: https://github.com/TonyWu20
  projects:
    - name: zmk
      remote: TonyWu20
      revision: b08f2c7b027d32daa3509131d4a3961ff4a1d65e
      import: app/west.yml
    - name: zmk-pmw3610-driver
      remote: TonyWu20
      revision: f7b7e23367d302cec3c9ce673cae4cb29ec158b6
  self:
    path: config
```
