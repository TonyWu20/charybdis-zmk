#include <dt-bindings/zmk/keys.h>

#define COMBO(NAME, BINDINGS, KEYPOS, LAYERS, MS) \
  combo_##NAME { \
    bindings = <BINDINGS>; \
    key-positions = <KEYPOS>; \
    layers = <LAYERS>; \
    timeout-ms = <MS>; \
    require-prior-idle-ms = <150>; \
  };

#define COMBO_TERM_FAST 14
#define COMBO_TERM_NORMAL 20
#define COMBO_TERM_SLOW 40

combos {
  compatible = "zmk,combos";

  /* HRM-mod combo: quick tap fires the click; holding N+I yields the LALT+LSHFT chord. */
  COMBO(l_leftclick, &hrc_n_i LS(LALT) LCLK, 11 12, BASE, COMBO_TERM_SLOW)
  COMBO(l_rightclick, &mkp RCLK, 21 22, BASE, COMBO_TERM_SLOW)
  COMBO(l_middleclick, &mkp MCLK, 22 23, BASE, COMBO_TERM_SLOW)

  /* HRM-mod combo: quick tap fires the click; holding H+O yields the RSHFT+RALT chord. */
  COMBO(r_leftclick, &hrc_h_o RS(RALT) LCLK, 17 18, BASE, COMBO_TERM_SLOW)
  COMBO(r_rightclick, &mkp RCLK, 27 28, BASE, COMBO_TERM_SLOW)
  COMBO(r_middleclick, &mkp MCLK, 26 27, BASE, COMBO_TERM_SLOW)
}; 
